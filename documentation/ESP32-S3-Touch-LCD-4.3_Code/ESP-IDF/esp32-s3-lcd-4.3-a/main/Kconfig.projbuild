## documentation/ESP32-S3-Touch-LCD-4.3_Code/ESP-IDF/esp32-s3-lcd-4.3-a/main/Kconfig.projbuild
```kconfig
menu "Example Configuration"
    config EXAMPLE_DOUBLE_FB
        bool "Use double Frame Buffer"
        default "n"
        help
            Enable this option, driver will allocate two frame buffers.

    config EXAMPLE_USE_BOUNCE_BUFFER
        depends on !EXAMPLE_DOUBLE_FB
        bool "Use bounce buffer"
        help
            Enable bounce buffer mode can achieve higher PCLK frequency at the cost of higher CPU consumption.

    config EXAMPLE_AVOID_TEAR_EFFECT_WITH_SEM
        depends on !EXAMPLE_DOUBLE_FB
        bool "Avoid tearing effect"
        default "y"
        help
            Enable this option, the example will use a pair of semaphores to avoid the tearing effect.
            Note, if the Double Frame Buffer is used, then we can also avoid the tearing effect without the lock.

    config EXAMPLE_FORMAT_IF_MOUNT_FAILED
        bool "Format the card if mount failed"
        default n
        help
            If this config item is set, format_if_mount_failed will be set to true and the card will be formatted if
            the mount has failed.

    config EXAMPLE_PIN_MOSI
        int "MOSI GPIO number"
        default 15 if IDF_TARGET_ESP32
        default 35 if IDF_TARGET_ESP32S2
        default 11 if IDF_TARGET_ESP32S3
        default 5  if IDF_TARGET_ESP32H2
        default 4  # C3 and others

    config EXAMPLE_PIN_MISO
        int "MISO GPIO number"
        default 2 if IDF_TARGET_ESP32
        default 37 if IDF_TARGET_ESP32S2
        default 13 if IDF_TARGET_ESP32S3
        default 0  if IDF_TARGET_ESP32H2
        default 6  # C3 and others

    config EXAMPLE_PIN_CLK
        int "CLK GPIO number"
        default 14 if IDF_TARGET_ESP32
        default 36 if IDF_TARGET_ESP32S2
        default 12 if IDF_TARGET_ESP32S3
        default 4  if IDF_TARGET_ESP32H2
        default 5  # C3 and others

    config EXAMPLE_PIN_CS
        int "CS GPIO number"
        default 13 if IDF_TARGET_ESP32
        default 34 if IDF_TARGET_ESP32S2
        default -1 if IDF_TARGET_ESP32S3
        default 1  # C3 and others
endmenu
```

## main/Kconfig.projbuild
```kconfig
menu "Device Configuration"

    orsource "$IDF_PATH/examples/common_components/env_caps/$IDF_TARGET/Kconfig.env_caps"

    config WIFI_SSID
        string "WiFi SSID"

    config WIFI_PASSWORD
        string "WiFi password"

    config MQTT_BROKER_URL
        string "MQTT broker URL"

    config MQTT_USER_ID
        string "MQTT user ID"

    config MQTT_PASSWORD
        string "MQTT password"

    config DEVICE_NAME
        string "Name of the device"

    config DEVICE_ENTITY_ID
        string "Entity ID of the device"

endmenu
```
